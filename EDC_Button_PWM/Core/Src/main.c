/* USER CODE BEGIN Header */
/**
  ******************************************************************************
  * @file           : main.c
  * @brief          : Main program body
  ******************************************************************************
  * @attention
  *
  * Copyright (c) 2025 STMicroelectronics.
  * All rights reserved.
  *
  * This software is licensed under terms that can be found in the LICENSE file
  * in the root directory of this software component.
  * If no LICENSE file comes with this software, it is provided AS-IS.
  *
  ******************************************************************************
  */
/* USER CODE END Header */
/* Includes ------------------------------------------------------------------*/
#include "main.h"
#include "dma.h"
#include "spi.h"
#include "tim.h"
#include "usart.h"
#include "gpio.h"

/* Private includes ----------------------------------------------------------*/
/* USER CODE BEGIN Includes */
#include <math.h>
#include <string.h> // 需要包含这个头文件来使用 memcpy
#define PI 3.14159

#define FLASH_CS_LOW()   HAL_GPIO_WritePin(FLASH_CS_GPIO_Port, FLASH_CS_Pin, GPIO_PIN_RESET)
#define FLASH_CS_HIGH()  HAL_GPIO_WritePin(FLASH_CS_GPIO_Port, FLASH_CS_Pin, GPIO_PIN_SET)
/* USER CODE END Includes */

/* Private typedef -----------------------------------------------------------*/
/* USER CODE BEGIN PTD */

/* USER CODE END PTD */

/* Private define ------------------------------------------------------------*/
/* USER CODE BEGIN PD */

/* USER CODE END PD */

/* Private macro -------------------------------------------------------------*/
/* USER CODE BEGIN PM */

/* USER CODE END PM */

/* Private variables ---------------------------------------------------------*/

/* USER CODE BEGIN PV */
uint16_t volume =80;
uint8_t pitch =60;
uint32_t last_interrupt_time=0;
uint32_t current_time=0;
uint8_t func=0;
static int freq=500;
static int count_S=0;
uint8_t percentage=0;


int scale=0;
//#define LENGTH 32
//int Music_Score[LENGTH]={60,0,60,0,67,0,67,0,69,0,69,0,67,0,0,0,65,0,65,0,64,0,64,0,62,0,62,0,60,0,0,0};
//#define LENGTH 32
//uint8_t Music_Score[LENGTH]={55,62,55,62,55,62,55,57,57,64,57,64,57,64,57,59,59,62,59,62,59,62,59,61,50,57,50,57,50,57,50,55};
#define LENGTH 624
uint8_t Music_Score[LENGTH]={
	
	0,0,0,0,0,0,0,0,0,0,0,0,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65
	
};
	
	
//音色
	//三角波
	//#define LENGTH_OF_WAVE 32
	//uint8_t Wave[LENGTH_OF_WAVE]={50,51,52,53,54,55,56,57,58,59,60,61,62,63,64,65,66,67,68,69,70,71,72,73,74,75,76,77,78,79,80,81};
	//方波
	#define LENGTH_OF_WAVE 10
	uint8_t Wave[LENGTH_OF_WAVE]={0,0,0,0,0,0,0,0,0,0};
//uint8_t datt[18000]={0x80,0x7F,0x80,0x7F,0x80,0x7F,0x80,0x7F,0x80,0x7F,0x80,0x80,0x81,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0x7D,0x7C};
uint8_t datt[18]={0};
	
	

/* USER CODE END PV */

/* Private function prototypes -----------------------------------------------*/
void SystemClock_Config(void);
/* USER CODE BEGIN PFP */
// 私有函数声明
void SPI_Flash_WriteEnable(void);
void SPI_Flash_WaitForWriteEnd(void);
void SPI_Flash_SectorErase(uint32_t sectorAddr);
void SPI_Flash_PageWrite(uint32_t pageAddr, uint8_t* data, uint16_t dataLen);
void SPI_Flash_ReadData(uint32_t readAddr, uint8_t* buffer, uint16_t len);
/* USER CODE END PFP */

/* Private user code ---------------------------------------------------------*/
/* USER CODE BEGIN 0 */

///////////////////////////////////////////////////////////////////////////////////////////////////////////////////////////////////////////
// 等待写/擦除操作完成
void SPI_Flash_WaitForWriteEnd(void)
{
    uint8_t status = 0;
    uint8_t cmd = 0x05; // Read Status Register command

    FLASH_CS_LOW();
    HAL_SPI_Transmit(&hspi1, &cmd, 1, HAL_MAX_DELAY);
    do {
        HAL_SPI_Receive(&hspi1, &status, 1, HAL_MAX_DELAY);
    } while ((status & 0x01) == 0x01); // 检查BUSY位(bit 0)是否为0
    FLASH_CS_HIGH();
}

// 写使能
void SPI_Flash_WriteEnable(void)
{
    FLASH_CS_LOW();
    uint8_t cmd = 0x06; // Write Enable command
    HAL_SPI_Transmit(&hspi1, &cmd, 1, HAL_MAX_DELAY);
    FLASH_CS_HIGH();
    // 可以加一个极小的延时，让芯片稳定一下
    HAL_Delay(1); 
}

void SPI_Flash_SectorErase(uint32_t sectorAddr)
{
    // 1. 发送写使能
    SPI_Flash_WriteEnable();

    // 2. 发送扇区擦除指令
    FLASH_CS_LOW();
    uint8_t cmd[4] = {0x20, (sectorAddr >> 16) & 0xFF, (sectorAddr >> 8) & 0xFF, sectorAddr & 0xFF};
    HAL_SPI_Transmit(&hspi1, cmd, 4, HAL_MAX_DELAY);
    FLASH_CS_HIGH();

    // 3. 等待擦除完成 (这一步至关重要！)
    SPI_Flash_WaitForWriteEnd();
}

void SPI_Flash_PageWrite(uint32_t pageAddr, uint8_t* data, uint16_t dataLen)
{
    // 1. 发送写使能
    SPI_Flash_WriteEnable();

    // 2. 发送页编程指令和数据
    FLASH_CS_LOW();
    uint8_t cmd[4] = {0x02, (pageAddr >> 16) & 0xFF, (pageAddr >> 8) & 0xFF, pageAddr & 0xFF};
    HAL_SPI_Transmit(&hspi1, cmd, 4, HAL_MAX_DELAY);
    HAL_SPI_Transmit(&hspi1, data, dataLen, HAL_MAX_DELAY);
    FLASH_CS_HIGH();

    // 3. 等待写入完成 (同样至关重要！)
    SPI_Flash_WaitForWriteEnd();
}


/**
 * @brief  读取数据
 * @param  readAddr: 读取的起始地址
 * @param  buffer: 存储读取数据的数据缓冲区
 * @param  len: 要读取的数据长度
 * @retval None
 */
void SPI_Flash_ReadData(uint32_t readAddr, uint8_t* buffer, uint16_t len)
{
    FLASH_CS_LOW();
    uint8_t cmd[4] = {0x03, (readAddr >> 16) & 0xFF, (readAddr >> 8) & 0xFF, readAddr & 0xFF};
    HAL_SPI_Transmit(&hspi1, cmd, 4, HAL_MAX_DELAY);
    HAL_SPI_Receive(&hspi1, buffer, len, HAL_MAX_DELAY);
    FLASH_CS_HIGH();
}

#define FLASH_PAGE_SIZE 256

/**
 * @brief  可以处理跨页的通用写入函数
 * @param  startAddr: 写入的起始地址
 * @param  data: 要写入的数据缓冲区
 * @param  totalLen: 要写入的总长度
 * @note   重要：调用此函数前，必须确保目标区域已被擦除！
 * @retval None
 */
void SPI_Flash_WriteData_CrossPage(uint32_t startAddr, uint8_t* data, uint32_t totalLen)
{
    uint32_t page_offset;
    uint16_t bytes_to_write_now;
    uint8_t* data_ptr = data;

    while(totalLen > 0)
    {
        // 1. 计算当前页的偏移量
        page_offset = startAddr % FLASH_PAGE_SIZE;

        // 2. 计算当前页还剩多少空间可以写
        uint16_t space_left_in_page = FLASH_PAGE_SIZE - page_offset;

        // 3. 决定本次写入多少字节
        if (totalLen < space_left_in_page) {
            // 如果剩余数据能写进当前页，就全部写入
            bytes_to_write_now = totalLen;
        } else {
            // 否则，只写满当前页剩余的空间
            bytes_to_write_now = space_left_in_page;
        }

        // 4. 执行一次页写入
        SPI_Flash_PageWrite(startAddr, data_ptr, bytes_to_write_now);

        // 5. 更新指针、地址和剩余长度，为下一次写入做准备
        startAddr += bytes_to_write_now;
        data_ptr += bytes_to_write_now;
        totalLen -= bytes_to_write_now;
    }
}




















/* USER CODE END 0 */

/**
  * @brief  The application entry point.
  * @retval int
  */
int main(void)
{

  /* USER CODE BEGIN 1 */

  /* USER CODE END 1 */

  /* MCU Configuration--------------------------------------------------------*/

  /* Reset of all peripherals, Initializes the Flash interface and the Systick. */
  HAL_Init();

  /* USER CODE BEGIN Init */

  /* USER CODE END Init */

  /* Configure the system clock */
  SystemClock_Config();

  /* USER CODE BEGIN SysInit */

  /* USER CODE END SysInit */

  /* Initialize all configured peripherals */
  MX_GPIO_Init();
  MX_DMA_Init();
  MX_TIM2_Init();
  MX_USART1_UART_Init();
  MX_SPI1_Init();
  MX_TIM4_Init();
  MX_TIM3_Init();
  /* USER CODE BEGIN 2 */
	HAL_TIM_PWM_Start(&htim2, TIM_CHANNEL_1);
	HAL_TIM_PWM_Start(&htim2, TIM_CHANNEL_2);
	HAL_TIM_Base_Start_IT(&htim3);
	HAL_TIM_Encoder_Start(&htim4, TIM_CHANNEL_ALL); // 启动TIM4的编码器接口
/*
	uint8_t large_data_buffer[300]; 
for(int i=0; i<300; i++) {
    large_data_buffer[i] = i; // 填充一些测试数据
}

uint32_t write_addr = 0x10F0; // 一个会导致跨页的起始地址
uint8_t read_buffer[300];

// 1. 【关键】先擦除！
// 我们的300字节数据都在0x1000这个4KB扇区内，所以擦除一次就够了。
SPI_Flash_SectorErase(0x1000); 

// 2. 【核心】调用新的跨页写入函数
SPI_Flash_WriteData_CrossPage(write_addr, large_data_buffer, 300);

// 3. 【验证】读取数据并比较
SPI_Flash_ReadData(write_addr, read_buffer, 300);

// 4. 检查读取的数据是否和写入的一致
int is_match = 1;
for(int i=0; i<300; i++) {
    if (read_buffer[i] != large_data_buffer[i]) {
        is_match = 0;
        break;
    }
}
if(is_match==1){
HAL_Delay(10);
}
HAL_Delay(10);
// 如果 is_match 为 true，说明跨页写入完全成功！
// 你可以在断点中查看 is_match 的值。
*/

// 假设你已经配置好了UART，并重定义了printf
// printf("Starting SPI Flash Test...\r\n");

uint8_t write_Buffer[] = "Hello SPI Flash! 1234567890"; // 测试数据
uint8_t read_Buffer[32];
uint32_t test_Address = 0x1000; // 选择一个测试地址，比如4KB的位置

// 1. 【诊断】先读取一下，看看这个地址里原来是什么
SPI_Flash_ReadData(test_Address, read_Buffer, 10);
// printf("Original data at 0x%X: %s\r\n", test_Address, read_Buffer);
// 在这里设置断点，查看read_Buffer

// 2. 【关键】执行完整的擦除流程
// printf("Erasing sector at 0x%X...\r\n", test_Address);
SPI_Flash_SectorErase(test_Address); // 这个函数内部已经包含了写使能和等待

// 3. 【诊断】擦除后再次读取，应该全是0xFF
SPI_Flash_ReadData(test_Address, read_Buffer, 10);
// printf("Data after erase: ");
// for(int i=0; i<10; i++) printf("0x%02X ", read_Buffer[i]);
// printf("\r\n");
// 在这里设置断点，检查read_Buffer里的每个字节是不是都是0xFF

// 4. 【关键】执行完整的写入流程
// printf("Writing data to flash...\r\n");
SPI_Flash_PageWrite(test_Address, write_Buffer, sizeof(write_Buffer)); // 内部包含写使能和等待

// 5. 【诊断】读取写入的数据，进行验证
// printf("Reading data back from flash...\r\n");
SPI_Flash_ReadData(test_Address, read_Buffer, sizeof(read_Buffer));
// printf("Data read back: %s\r\n", read_Buffer);
// 在这里设置断点，查看read_Buffer是否和write_Buffer完全一致

// 如果一致，恭喜你，Flash读写成功了！
HAL_Delay(150);HAL_Delay(150);
HAL_Delay(150);HAL_Delay(150);



/*
	uint8_t write_Buffer[] = "STM32 C8T6 SPI Flash Test!";
uint8_t read_Buffer[32];
uint32_t flash_Address = 0x0000; // 选择一个起始地址

// 1. 先擦除要写入的扇区
SPI_Flash_SectorErase(flash_Address);
HAL_Delay(10); // 可以加个小延时，确保擦除稳定

// 2. 写入数据
SPI_Flash_PageWrite(flash_Address, write_Buffer, sizeof(write_Buffer));
HAL_Delay(10);

// 3. 读取数据
SPI_Flash_ReadData(flash_Address, read_Buffer, sizeof(read_Buffer));

// 4. 此时，read_Buffer里的内容应该和write_Buffer一样了
// 你可以通过设置断点查看read_Buffer的值，或者通过串口打印出来
*/
	scale=60;
  /* USER CODE END 2 */

  /* Infinite loop */
  /* USER CODE BEGIN WHILE */
  while (1)
  {	
		
		static uint16_t encoder=0;
		static uint16_t last_encoder=0;
		encoder=__HAL_TIM_GET_COUNTER(&htim4);
		int delta=encoder-last_encoder;
		if(delta>1000||delta<-1000)delta=0;
		last_encoder=encoder;
		if(func==0){volume+=delta/4;}
		if(func==1){pitch+=delta/4;scale=pitch;}
		
		//HAL_GPIO_TogglePin(GPIOC,GPIO_PIN_13);
		//uint8_t write_Buffer[]="Hello!";
		//uint8_t read_Buffer[300]={0};
		//SPI_Flash_PageWrite(0x00000000, write_Buffer, sizeof(write_Buffer)); // 内部包含写使能和等待
		//SPI_Flash_ReadData(0x10F0, read_Buffer, sizeof(read_Buffer));
		//HAL_Delay(10);
		if(count_S==LENGTH)count_S=0;
		
		if(func==2){scale=Music_Score[count_S];HAL_Delay( 0);}
		
		freq=440*pow(2,(scale-69.0)/12.0)*LENGTH_OF_WAVE/2;
		int AAR = 1e6/freq;
		if(Music_Score[count_S]!=0){
			HAL_TIM_PWM_Start(&htim2, TIM_CHANNEL_1);
			HAL_TIM_PWM_Start(&htim2, TIM_CHANNEL_2);
		}else{
			HAL_TIM_PWM_Stop(&htim2, TIM_CHANNEL_1);
			HAL_TIM_PWM_Stop(&htim2, TIM_CHANNEL_2);
		}
		__HAL_TIM_SET_AUTORELOAD(&htim3,AAR ); // 使用宏设置//播放音乐请注释
		count_S++;
		//HAL_GPIO_WritePin(GPIOC,GPIO_PIN_13,GPIO_PIN_SET);
		HAL_Delay(70);
		//HAL_GPIO_WritePin(GPIOC,GPIO_PIN_13,GPIO_PIN_RESET);
		//HAL_Delay(150);
    /* USER CODE END WHILE */

    /* USER CODE BEGIN 3 */
		 
  }
  /* USER CODE END 3 */
}

/**
  * @brief System Clock Configuration
  * @retval None
  */
void SystemClock_Config(void)
{
  RCC_OscInitTypeDef RCC_OscInitStruct = {0};
  RCC_ClkInitTypeDef RCC_ClkInitStruct = {0};

  /** Initializes the RCC Oscillators according to the specified parameters
  * in the RCC_OscInitTypeDef structure.
  */
  RCC_OscInitStruct.OscillatorType = RCC_OSCILLATORTYPE_HSE;
  RCC_OscInitStruct.HSEState = RCC_HSE_ON;
  RCC_OscInitStruct.HSEPredivValue = RCC_HSE_PREDIV_DIV1;
  RCC_OscInitStruct.HSIState = RCC_HSI_ON;
  RCC_OscInitStruct.PLL.PLLState = RCC_PLL_ON;
  RCC_OscInitStruct.PLL.PLLSource = RCC_PLLSOURCE_HSE;
  RCC_OscInitStruct.PLL.PLLMUL = RCC_PLL_MUL9;
  if (HAL_RCC_OscConfig(&RCC_OscInitStruct) != HAL_OK)
  {
    Error_Handler();
  }

  /** Initializes the CPU, AHB and APB buses clocks
  */
  RCC_ClkInitStruct.ClockType = RCC_CLOCKTYPE_HCLK|RCC_CLOCKTYPE_SYSCLK
                              |RCC_CLOCKTYPE_PCLK1|RCC_CLOCKTYPE_PCLK2;
  RCC_ClkInitStruct.SYSCLKSource = RCC_SYSCLKSOURCE_PLLCLK;
  RCC_ClkInitStruct.AHBCLKDivider = RCC_SYSCLK_DIV1;
  RCC_ClkInitStruct.APB1CLKDivider = RCC_HCLK_DIV2;
  RCC_ClkInitStruct.APB2CLKDivider = RCC_HCLK_DIV1;

  if (HAL_RCC_ClockConfig(&RCC_ClkInitStruct, FLASH_LATENCY_2) != HAL_OK)
  {
    Error_Handler();
  }
}

/* USER CODE BEGIN 4 */
void HAL_GPIO_EXTI_Callback(uint16_t GPIO_Pin)
{
  // 1. 判断是哪个引脚触发了中断
  // 因为你配置的是PB2，所以这里判断GPIO_PIN_2
  if(GPIO_Pin == RS_Pin)
  {
		 uint32_t current_time = HAL_GetTick();//获取当前时间用于按键消抖


    if(current_time - last_interrupt_time > 100)//判断当前时间与上一次中断触发时间的间隔是否大于50ms，用于消抖
    {
			//=======================================EXTI=========================================
      //there are codes which will be activated when the EXTI happened.
				//HAL_GPIO_TogglePin(GPIOC,GPIO_PIN_13);
				func++;
				if(func==3)func=0;
				if(func==2)count_S=0;
			}
    }
	if(GPIO_Pin == KEY_UP_Pin)
  {
		 uint32_t current_time = HAL_GetTick();//获取当前时间用于按键消抖


    if(current_time - last_interrupt_time > 100)//判断当前时间与上一次中断触发时间的间隔是否大于50ms，用于消抖
    {
			//=======================================EXTI=========================================
      //there are codes which will be activated when the EXTI happened.
				//HAL_GPIO_TogglePin(GPIOC,GPIO_PIN_13);
				percentage+=1;
			if(percentage>10)percentage=0;
			for(int i=0;i<10;i++)
				{
					Wave[i]=0;
				}
			for(int i=0;i<percentage;i++){
				Wave[i]=90;
				}
			}
    }
    last_interrupt_time = current_time;//更新上一次中断触发时间
		
    // 2. 在这里写你的中断处理代码
    
    // --- 示例：翻转一个LED ---
    // 假设你在PC13上接了一个LED，并且在CubeMX里配置好了
     

    // --- 示例：发送一个串口信息 ---
    // 注意：中断函数里要避免使用printf等耗时操作，可以用快速的非阻塞方式
    // printf("PB2 Interrupt Triggered!\r\n"); // 不推荐在中断里用

    // --- 示例：设置一个全局标志位 ---
    // 定义一个全局变量 volatile bool pb2_flag = false;
    // 在这里设置 pb2_flag = true;
    // 然后在main循环里检查这个标志位来处理事件
  
}
void HAL_TIM_PeriodElapsedCallback(TIM_HandleTypeDef *htim)
{
  if(htim->Instance == TIM3)
  {
		/*
    static uint32_t counter1 = 0;
		static uint32_t counter2 = 0;
		static int mcount;
		static int freq=100;
		static int count=0;
		count++;
		mcount=1.0/freq*1000;
		if(count%100==0){freq++;}
    counter1++;
		counter2++;
		if(freq==1000){freq=0;}
		if(counter1==mcount){counter1=0;}
		if(counter2==mcount){counter2=0;}
		int dac0=100*(1+sin(2*PI/mcount*counter1));
		int dac1=100*(1+cos(2*PI/mcount*counter2));
		//int dac0=counter1;
		//int dac1=counter2;
		__HAL_TIM_SET_COMPARE(&htim2, TIM_CHANNEL_1, dac0);
		__HAL_TIM_SET_COMPARE(&htim2, TIM_CHANNEL_2, dac1);
		*/
		
		static short int wave_counter=0;
		wave_counter++;
		if(wave_counter==LENGTH_OF_WAVE)wave_counter=0;
		
		__HAL_TIM_SET_COMPARE(&htim2, TIM_CHANNEL_1, Wave[wave_counter]*volume/100);
		__HAL_TIM_SET_COMPARE(&htim2, TIM_CHANNEL_2, Wave[wave_counter]*volume/100);
		//__HAL_TIM_SET_COMPARE(&htim2, TIM_CHANNEL_1, Wave[wave_counter]);
		//__HAL_TIM_SET_COMPARE(&htim2, TIM_CHANNEL_2, Wave[wave_counter]);
		/*
		static uint32_t counter = 0;
		counter+=2;
		if(counter==18000){counter=0;}
		__HAL_TIM_SET_COMPARE(&htim2, TIM_CHANNEL_1, datt[counter]);
		__HAL_TIM_SET_COMPARE(&htim2, TIM_CHANNEL_2, datt[counter+1]);
		*/
		
		
		
		
		
		
		
		
		
		
		
		
		
		
		
		
		
		
		
		
		
		
		
		
		
		
		
		
		
		
		
		
    
    // ������ˢ����ı���
    // ���磺ÿ1msִ��һ��
  }
}


/* USER CODE END 4 */

/**
  * @brief  This function is executed in case of error occurrence.
  * @retval None
  */
void Error_Handler(void)
{
  /* USER CODE BEGIN Error_Handler_Debug */
  /* User can add his own implementation to report the HAL error return state */
  __disable_irq();
  while (1)
  {
  }
  /* USER CODE END Error_Handler_Debug */
}
#ifdef USE_FULL_ASSERT
/**
  * @brief  Reports the name of the source file and the source line number
  *         where the assert_param error has occurred.
  * @param  file: pointer to the source file name
  * @param  line: assert_param error line source number
  * @retval None
  */
void assert_failed(uint8_t *file, uint32_t line)
{
  /* USER CODE BEGIN 6 */
  /* User can add his own implementation to report the file name and line number,
     ex: printf("Wrong parameters value: file %s on line %d\r\n", file, line) */
  /* USER CODE END 6 */
}
#endif /* USE_FULL_ASSERT */
